## daughter/code/main/Kconfig.projbuild
```kconfig
menu "Power Configuration"

    config IGNITION_WIRE_IO
        int "Ignition power GPIO number"
        default 12
        help
            This option selects the GPIO pin used for the main power signal.

    config MAIN_POWER_IO
        int "Main power GPIO number"
        default 18
        help
            This option selects the GPIO pin used for the main power signal.

    config DISPLAY_POWER_IO
        int "Display power GPIO number"
        default 15
        help
            This option selects the GPIO pin used for the display power signal.

    config AUDIO_STBY_IO
        int "Audio standby power GPIO number"
        default 33
        help
            This option selects the GPIO pin used for the audio power signal.

    config AUDIO_MUTE_IO
      int "Audio mute power GPIO number"
      default 32
      help
            This option selects the GPIO pin used for the audio power signal.

endmenu

menu "CAN Configuration"

    config CAN_TX_GPIO_NUM
        int "TX GPIO number"
        default 5
        help
            This option selects the GPIO pin used for the TX signal. Connect the
            TX signal to your transceiver.

    config CAN_RX_GPIO_NUM
        int "RX GPIO number"
        default 4
        help
            This option selects the GPIO pin used for the RX signal. Connect the
            RX signal to your transceiver.

endmenu

menu "J1850 Configuration"

    config J1850_INPUT_PIN
        int "Input GPIO number"
        default 16
        help
            This option selects the GPIO pin used for the j1850 input signal.

    config J1850_OUTPUT_PIN
        int "Output GPIO number"
        default 17
        help
            This option selects the GPIO pin used for the j1850 output signal.

endmenu

menu "Wifi Configuration"

    config ESP_WIFI_SSID
        string "WiFi SSID"
        default "myssid"
        help
            SSID (network name) for the example to connect to.

    config ESP_WIFI_PASSWORD
        string "WiFi Password"
        default "mypassword"
        help
            WiFi password (WPA or WPA2) for the example to use.
    config ESP_WIFI_CHANNEL
        int "WiFi Channel"
        range 1 13
        default 1
        help
            WiFi channel (network channel) for the example to use.

    config ESP_MAX_STA_CONN
        int "Maximal STA connections"
        default 4
        help
            Max number of the STA connects to AP.
endmenu
```
